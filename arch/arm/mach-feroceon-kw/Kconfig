## arch/arm/plat-feroceon/mv_drivers_lsp/mv_network/Kconfig
```kconfig
config MV_ETHERNET
        bool "Networking Support"
	depends on MV_INCLUDE_GIG_ETH
        ---help---
        Choose this option to support Marvell Gigabit Ethernet Controller 

config MV_ETH_PORTS_NUM
	int "Number of Marvell Giga Ethernet controllers"
	depends on MV_ETHERNET
	default 0 

if MV_ETHERNET

menu "Network Interface Configuration"

config  OVERRIDE_ETH_CMDLINE
	bool "Override command line definitions for SoC Networking"
	default n
	---help---
	Choosing this option will override MAC address and MTU definition of kernel command line.
	The GbE driver will use the setting from kernel config

config  MV_ETH_0_MTU
	int "Giga port #0 MTU value"
	depends on (MV_ETH_PORTS_NUM != 0)
 	default 1500
        ---help---
	Default MTU value for Marvell Giga port #0

config  MV_ETH_0_MACADDR
        string "Giga port #0 MAC Address"
        depends on (MV_ETH_PORTS_NUM != 0)
        default "00:00:00:00:00:80"
        ---help---
        Default MAC address for Marvell Giga port #0 

config  MV_ETH_1_MTU
        int "Giga port #1 MTU value"
        depends on (MV_ETH_PORTS_NUM != 0) && (MV_ETH_PORTS_NUM != 1)
        default 1500
        ---help---
	Default MTU value for Marvell Giga port #1

config  MV_ETH_1_MACADDR
        string "Giga port #1 MAC Address"
        depends on (MV_ETH_PORTS_NUM != 0) && (MV_ETH_PORTS_NUM != 1)
        default "00:00:00:00:00:81"
        ---help---
        Default MAC address for Marvell Giga port #1

config  MV_ETH_2_MTU
        int "Giga port #2 MTU value"
        depends on (MV_ETH_PORTS_NUM != 0) && (MV_ETH_PORTS_NUM != 1) && (MV_ETH_PORTS_NUM != 2)
        default 1500
        ---help---
        Default MTU value for Marvell Giga port #2

config  MV_ETH_2_MACADDR
        string "Giga port #2 MAC Address"
        depends on (MV_ETH_PORTS_NUM != 0) && (MV_ETH_PORTS_NUM != 1) && (MV_ETH_PORTS_NUM != 2)
        default "00:00:00:00:00:82"
        ---help---
        Default MAC address for Marvell Giga port #2

config  MV_ETH_3_MTU
        int "Giga port #3 MTU value"
        depends on (MV_ETH_PORTS_NUM != 0) && (MV_ETH_PORTS_NUM != 1) && (MV_ETH_PORTS_NUM != 2) && (MV_ETH_PORTS_NUM != 3)
        default 1500
        ---help---
        Default MTU value for Marvell Giga port #3

config  MV_ETH_3_MACADDR
        string "Giga port #3 MAC Address"
        depends on (MV_ETH_PORTS_NUM != 0) && (MV_ETH_PORTS_NUM != 1) && (MV_ETH_PORTS_NUM != 2) && (MV_ETH_PORTS_NUM != 3)
        default "00:00:00:00:00:83"
        ---help---
        Default MAC address for Marvell Giga port #3

endmenu
endif

if MV_ETHERNET
menu "Rx/Tx Queue Configuration"

config  MV_ETH_RXQ
        int "Number of RX queues"
        default 1
        ---help---
          Multiple RX queue support.

config  MV_ETH_TXQ
        int "Number of TX queues"
        default 1
        ---help---
          Multiple TX queue support.

config MV_ETH_NUM_OF_RX_DESCR
	int "Number of Rx descriptors"
	depends on (MV_ETH_PORTS_NUM != 0)
	default 128
        ---help---
	The number of Rx descriptors in each Rx queue.

config MV_ETH_NUM_OF_TX_DESCR
	int "Number of Tx descriptors"
	depends on (MV_ETH_PORTS_NUM != 0)
	default 532
        ---help---
	The number of Tx descriptors in each Tx queue.

endmenu
endif

if MV_ETHERNET
menu "TCP/UDP Offloading"

config  MV_ETH_TSO
        bool "TSO Support for Marvell network interface"
	default y
        ---help---
        Adds TSO support for TCP segmentation offload on Marvell network interface.

config  MV_ETH_UFO
        bool "UFO Support for Marvell network interface"
        ---help---
        Adds UFO support for transmit UDP buffers larger than MTU size on 
        Marvell network interface.
        UFO stands for UDP Fragmentation Offload
endmenu
endif

if MV_ETHERNET
menu "Control and Statistics"

config  MV_ETH_TOOL
	bool "Support ethtool controls"
	default y
	---help---
	Support kernel's SIOCETHTOOL for ethtool utility

config  MV_ETH_PROC
	bool "Support eth proc FS "
	default y
	---help---
	  Use mv_eth_tool to control Marvell network interface driver.

config  MV_ETH_STATS_ERROR
        bool "Collect error statistics"
	---help---
	Marvell network interface driver collect minimal number of statistics. 
	Only for error conditions. Can be displayed using mv_eth_tool.

config  MV_ETH_STATS_INFO
        bool "Collect event statistics"
        ---help---
	Marvell network interface driver collect event statistics. 
	Provide more information about driver functionality and almost doesn't 
	effect performance. Can be displayed using mv_eth_tool.

config  MV_ETH_STATS_DEBUG
        bool "Collect debug statistics"
        ---help---
	Marvell network interface driver collect a lot of statistics. 
	Used for Debug mode. Decrease performance. Can be displayed using mv_eth_tool.

config  MV_LINUX_COUNTERS_DISABLE
	bool "Disable collection of SNMP statistics and Netfilter Contract statistics"
	default n
	---help---
	Disable collection of SNMP statistics and Netfilter Contract statistics to improve performance.

endmenu
endif

if (MV_ETHERNET)
menu "Advanced Features"

config  MV_ETH_TIMER_PERIOD
        int "Periodical timer period"
        default 10
        ---help---
          Periodical timer period for clenup in [msec].

config	MV_ETH_SKB_REUSE
	bool "Try to reuse SKB"
	default y
	---help---
	  Reuse SKB from TX to RX

config MV_ETH_SKB_REUSE_DEF
        depends on MV_ETH_SKB_REUSE
        int "Default value for SKB reuse:  0 - disable, 1 - enable"
        default 0
        ---help---

config  NET_SKB_HEADROOM
        int "SKB headroom size"
        default 64
        ---help---
          Customize SKB headroom size. Must be power of 2.

config  NET_SKB_RECYCLE
        bool "Try to recycle SKB"
        default y
        ---help---
          Recycle SKB via callback in 'struct sk_buff'

config NET_SKB_RECYCLE_DEF
        depends on NET_SKB_RECYCLE
        int "Default value for SKB recycle:  0 - disable, 1 - enable"
        default 0
        ---help---

config  MV_ETH_NFP
        bool "Use Network Fast Processing (NFP)"
	default y
        ---help---
        Choosing this option will include NFP support in the image.

config MV_ETH_NFP_DEF
        depends on MV_ETH_NFP
        int "Default value for NFP:  0 - disable, 1 - enable"
        default 0
        ---help---

config MV_ETH_NFP_AGING_TIMER
        int "NFP aging timer interval"
        depends on MV_ETH_NFP
        default 15
        ---help---
        The NFP aging mechanism timer interval. If unsure, leave default value.

config  MV_ETH_NFP_TOS
        bool "Support ToS on NFP routing path"
	depends on MV_ETH_NFP && IP_NF_TARGET_TOS
        ---help---
        Choosing this option will include NFP ToS support in the image.

config MV_ETH_NFP_NAT_SUPPORT
        bool "Support NFP NAT"
        depends on MV_ETH_NFP && (NF_CONNTRACK_ENABLED || NF_CONNTRACK_IPV4)
        ---help---
        Choosing this option will enable NFP NAT support.

config MV_ETH_NFP_FDB_SUPPORT
	bool "Support NFP Bridging"
	depends on MV_ETH_NFP && BRIDGE
	default n
	 ---help---
	Choosing this option will enable NFP Bridging.

config MV_ETH_NFP_PPP
        bool "Support NFP PPPoE"
        depends on MV_ETH_NFP && PPPOE
        default n
         ---help---
        Choosing this option will enable NFP PPPoE protocol.

config MV_ETH_NFP_SEC
	bool "Support NFP Ipsec"
        depends on MV_ETH_NFP && !MV_CESA_OCF && !MV_CESA_TEST
        default n
         ---help---
        Choosing this option will enable NFP IPsec protocol.

config	MV_NFP_SEC_5TUPLE_KEY_SUPPORT 
	bool "Support 5 tuple key search match"
        depends on MV_ETH_NFP_SEC
        default y
         ---help---
        Choosing this option will enable 5 tuple key search match support.

config MV_ETH_NFP_SEC_HUB
	bool "Support hub and spoke vpn"
	depends on MV_ETH_NFP_SEC
	default n
	---help---
	Choosing this option will enable hub-and-spoke vpn with NFP.

config  MV_NFP_STATS
        bool "Collect NFP statistics"
	depends on MV_ETH_NFP
        default n
        ---help---
        Collect NFP statistics. Can be displayed using mv_eth_tool.

endmenu
endif

config MV_GATEWAY
        bool "Gateway support"
	depends on MV_INCLUDE_SWITCH
	depends on MV_ETHERNET
        ---help---
	Choose this option to support Gigabit Ethernet Controller connected to 
        on-board QuarterDeck switch family

if MV_GATEWAY

menu "Gateway Interface Configuration"

config  MV_GTW_CONFIG
	string "Network interface configuration"
	default "(00:11:66:11:66:11,0)(00:22:77:22:77:22,1:2:3:4),mtu=1500"
	---help---
	 Set the network interface configuration. For each interface, define the interface 
	 name, MAC address and participating ports, at the end (optionally) set the 
         interfaces MTU. For example, the default configuration defines two interfaces, 
         eth0 and eth1, and sets the MTU to 1500.

endmenu

menu "Gateway Features"

config  MV_GTW_IGMP
        bool "L2 IGMP Snooping support"
        default y
        ---help---
          Support L2 IGMP snooping at the switch level, i.e. directing L3 routed multicast
          stream to the specific L2 port which originally received an IGMP Join message,
          instead of fluding all VLAN ports.

config  MV_GTW_LINK_STATUS
	bool "Link status change indications"
	default y
	---help---
	  Support Phy link status change indications.

endmenu

endif
```

## arch/arm/plat-feroceon/mv_drivers_lsp/mv_phone/Kconfig
```kconfig
menu "Telephony options"
	depends on MV_INCLUDE_TDM

config  MV_PHONE
	tristate "Support for Marvell telephony(VoIP)"
	depends on MV_INCLUDE_TDM && PHONE
	default y
	---help---
	  Choosing this option enables the Marvell telephony underlying 
	  support for various VoIP applications. 
	  Note, kernel Telephony subsystem must be chosen too.

choice 
	prompt "TDM unit"
	depends on MV_PHONE

config MV_TDM_2CHANNELS
	bool "Support legacy TDM unit(2 channels)"

config MV_TDM_32CHANNELS
	bool "Support FlexTDM unit(up to 32 channels)"

endchoice

config MV_TDM_USE_EXTERNAL_PCLK_SOURCE
	bool "Support PCLK from external source"
	depends on MV_PHONE
	default n
	---help---
	Choosing this option enables TDM unit to use PCLK supplied by external source.

config MV_PHONE_TEST_MODULE
	tristate "Support phone testing module"
	depends on MV_PHONE
	help
	  Phone test module supports several basic telephony tests for Marvell TDM based platforms. 

endmenu
```

## arch/arm/plat-feroceon/mv_drivers_lsp/mv_xor/Kconfig
```kconfig
config MV_XOR_NET_DMA
        bool "Use the XOR engine as NET DMA"
        depends on NET_DMA && NOT_SUPPORTED
        default n
        help
          Invokes XOR as NET DMA engine

config MV_USE_XOR_ENGINE
        bool "Use the XOR engines to offload CPU tasks"   
        depends on (MV_INCLUDE_XOR) && EXPERIMENTAL
        default n
        help
            Say Y of you want to use the XOR engine to offload some of the 
            CPU tasks.

config MV_XOR_MEMCOPY
        bool "Use the XOR engine to accelerate memcpy()"
        depends on MV_USE_XOR_ENGINE
        default n
        help
          Say Y here if you want to use the XOR engine to perform
          the memcpy and memmove.

config MV_XOR_MEMCOPY_THRESHOLD
        int "Minimum number of bytes to use XOR acceleration for memcpy()"
        depends on MV_XOR_MEMCOPY
        default "128"
        help
          This is the minimum buffer size needed in order to operate the XOR engine
          for accelerating the memcpy() operations

config MV_XOR_MEMXOR
        bool "Use the XOR engine to perform xor bitmap calculations"
        depends on MV_USE_XOR_ENGINE
        default n
        help
          Say Y to accelerate the RAID4/5 xor bitmap calculations.

config MV_XOR_MEMXOR_THRESHOLD
        int "Minimum number of bytes to perform xor bitmap calculations"
        depends on MV_XOR_MEMXOR
        default "4096"
        help
          This is the minimum buffer size to operate the XOR engine
          for xor bitmap operations

config MV_XOR_COPY_TO_USER
	bool "Use XOR hardware to accelerate copy_to_user function"
	depends on MV_USE_XOR_ENGINE
	default n
	help
	  Say Y here to accelerate the copy_to_user function

config MV_XOR_COPY_TO_USER_THRESHOLD
        int "A threshold to employ XOR hardware for copy_to_user()"
        depends on MV_XOR_COPY_TO_USER
        default "1260"
        help
          This is the minimum buffer size required to operate XOR engine
          to accelerate the copy_to_user() operation.

config MV_XOR_COPY_FROM_USER
	bool "Use XOR hardware to accelerate copy_from_user function"
	depends on MV_USE_XOR_ENGINE
	default n
	help
	  Say Y here to accelerate the copy_from_user function

config MV_XOR_COPY_FROM_USER_THRESHOLD
        int "A threshold to employ XOR hardware for copy_from_user()"
        depends on MV_XOR_COPY_FROM_USER
        default "1260"
        help
          This is the minimum buffer size required to operate XOR engine
          to accelerate the copy_from_user() operation.

config MV_XOR_CHANNELS
        int "Number of XOR channels"
        depends on MV_USE_XOR_ENGINE
        range 1 4
        default 2
	help
	  Select the number of XOR channels to be used for kernel functions
	  accelerations.
#endmenu

##source	"drivers/dma/Kconfig"
```

## drivers/ata/mvSata_4_2_2/Kconfig
```kconfig
menuconfig SCSI_MVSATA_BSP422
        tristate "Marvell BSP SATA driver (Version 422)"
        depends on PCI
        ---help---
		This module is abstracted from arch/arm/plat-feroceon.

if SCSI_MVSATA_BSP422	

config  MV_SATA_SUPPORT_ATAPI_BSP422
        bool "Support ATAPI (CR-ROM/DVD-ROM) devices"
        default n

config  MV_SATA_ENABLE_1MB_IOS_BSP422
        bool "Enable 1 MByte requests"
        default n
        help
          Set the maximum io request size to 1 MByte for HDD's the support LBA48 feature,
          say No if you want to keep the maximum limit on 128KBytes.
choice
	prompt "Debug level"
	default SATA_NO_DEBUG_BSP422

config SATA_NO_DEBUG_BSP422
	bool "No Debug"

config SATA_DEBUG_ON_ERROR_BSP422
	bool "Debug on errors"
	help
	  print debug messages when EDMA/System/HDD errors occur.

config SATA_FULL_DEBUG_BSP422
	bool "Full debug"

endchoice

endif #SCSI_MVSATA_BSP422
```
